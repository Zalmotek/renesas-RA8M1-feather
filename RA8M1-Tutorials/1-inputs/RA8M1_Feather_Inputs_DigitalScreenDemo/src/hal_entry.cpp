#include "genieArduinoDEV.h"
#include "SerialCompatibility.h"
#include "digital.h"

FSP_CPP_HEADER
void R_BSP_WarmStart(bsp_warm_start_event_t event);
FSP_CPP_FOOTER

#define RESET_PIN 0x010C    //D10
#define ENDSTOP_PIN 0x040E  //D6
#define DEBOUNCE_CNT 500000

char const *msg = "OBJECT DETECTED";

/*******************************************************************************************************************//**
 * main() is generated by the RA Configuration editor and is used to generate threads if an RTOS is used.  This function
 * is called by main() when no RTOS is used.
 **********************************************************************************************************************/
void hal_entry(void)
{
    Serial1.begin(115200);
    Genie genie(&Serial1);
    R_IOPORT_Open(&g_ioport_ctrl, &g_bsp_pin_cfg);
    pinMode(RESET_PIN, OUTPUT);
    pinMode(ENDSTOP_PIN, INPUT);
    digitalWrite(RESET_PIN, LOW);
    delay(100);
    digitalWrite(RESET_PIN, HIGH);
    delay(500);

    int cnt = 0;

    bool endstopState, msgState = true;
    if (genie.Begin()) {
        for (int i = 0; i < 3; i++) {
            genie.WriteStr(0, (char*)"");
            delay(500);
            tick += 500;
            genie.WriteStr(0, (char*)"alo");
            delay(500);
            tick += 500;
            endstopState = !digitalRead(ENDSTOP_PIN);
        }
        while (true) {
            /*
            genie.WriteStr(0, (char*)"");
            delay(500);
            tick += 500;
            genie.WriteStr(0, (char*)"alo");
            delay(500);
            tick += 500;
            */

            //tick += 5;
            endstopState = !digitalRead(ENDSTOP_PIN);

            if (endstopState) {
                if (msgState == false) {
                    genie.WriteStr(0, msg);
                }
                cnt = DEBOUNCE_CNT;
                msgState = true;
            }
            else if (cnt == 0 && msgState == true) {
                genie.WriteStr(0, (char*)"");
                msgState = false;
            }
            if (cnt > 0) {
                cnt--;
            }
        }
    }
    else {
        APP_PRINT("Failed to start\n");
    }

#if BSP_TZ_SECURE_BUILD
    /* Enter non-secure code */
    R_BSP_NonSecureEnter();
#endif
}

/*******************************************************************************************************************//**
 * This function is called at various points during the startup process.  This implementation uses the event that is
 * called right before main() to set up the pins.
 *
 * @param[in]  event    Where at in the start up process the code is currently at
 **********************************************************************************************************************/
void R_BSP_WarmStart(bsp_warm_start_event_t event)
{
    if (BSP_WARM_START_RESET == event)
    {
#if BSP_FEATURE_FLASH_LP_VERSION != 0

        /* Enable reading from data flash. */
        R_FACI_LP->DFLCTL = 1U;

        /* Would normally have to wait tDSTOP(6us) for data flash recovery. Placing the enable here, before clock and
         * C runtime initialization, should negate the need for a delay since the initialization will typically take more than 6us. */
#endif
    }

    if (BSP_WARM_START_POST_C == event)
    {
        /* C runtime environment and system clocks are setup. */

        /* Configure pins. */
        R_IOPORT_Open (&g_ioport_ctrl, &IOPORT_CFG_NAME);
    }
}

#if BSP_TZ_SECURE_BUILD

FSP_CPP_HEADER
BSP_CMSE_NONSECURE_ENTRY void template_nonsecure_callable ();

/* Trustzone Secure Projects require at least one nonsecure callable function in order to build (Remove this if it is not required to build). */
BSP_CMSE_NONSECURE_ENTRY void template_nonsecure_callable ()
{

}
FSP_CPP_FOOTER

#endif
