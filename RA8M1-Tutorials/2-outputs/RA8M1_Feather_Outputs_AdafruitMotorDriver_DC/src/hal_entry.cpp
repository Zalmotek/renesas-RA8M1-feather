#include "Adafruit_MotorShield.h"

FSP_CPP_HEADER
void R_BSP_WarmStart(bsp_warm_start_event_t event);
FSP_CPP_FOOTER

/*******************************************************************************************************************//**
 * main() is generated by the RA Configuration editor and is used to generate threads if an RTOS is used.  This function
 * is called by main() when no RTOS is used.
 **********************************************************************************************************************/
void hal_entry(void)
{
    // Create the motor shield object with the default I2C address
    Adafruit_MotorShield AFMS = Adafruit_MotorShield();
    // Or, create it with a different I2C address (say for stacking)
    // Adafruit_MotorShield AFMS = Adafruit_MotorShield(0x61);


    Adafruit_DCMotor *myMotor = AFMS.getMotor(1);

    if (!AFMS.begin()) {         // create with the default frequency 1.6KHz
        // if (!AFMS.begin(1000)) {  // OR with a different frequency, say 1KHz
        APP_PRINT("Could not find Motor Shield. Check wiring.\n");
        while (1);
    }
    APP_PRINT("Motor Shield found.\n");

    // Set the speed to start, from 0 (off) to 255 (max speed)
    myMotor->setSpeed(150);
    myMotor->run(FORWARD);
    // turn on motor
    myMotor->run(RELEASE);

    while (true) {
        uint8_t i;

          APP_PRINT("tick ");

          myMotor->run(FORWARD);
          for (i=0; i<255; i++) {
            myMotor->setSpeed(i);
            delay(10);
          }
          for (i=255; i!=0; i--) {
            myMotor->setSpeed(i);
            delay(10);
          }

          APP_PRINT("tock ");

          myMotor->run(BACKWARD);
          for (i=0; i<255; i++) {
            myMotor->setSpeed(i);
            delay(10);
          }
          for (i=255; i!=0; i--) {
            myMotor->setSpeed(i);
            delay(10);
          }

          APP_PRINT("tech\n");
          myMotor->run(RELEASE);
          delay(1000);
    }

#if BSP_TZ_SECURE_BUILD
    /* Enter non-secure code */
    R_BSP_NonSecureEnter();
#endif
}

/*******************************************************************************************************************//**
 * This function is called at various points during the startup process.  This implementation uses the event that is
 * called right before main() to set up the pins.
 *
 * @param[in]  event    Where at in the start up process the code is currently at
 **********************************************************************************************************************/
void R_BSP_WarmStart(bsp_warm_start_event_t event)
{
    if (BSP_WARM_START_RESET == event)
    {
#if BSP_FEATURE_FLASH_LP_VERSION != 0

        /* Enable reading from data flash. */
        R_FACI_LP->DFLCTL = 1U;

        /* Would normally have to wait tDSTOP(6us) for data flash recovery. Placing the enable here, before clock and
         * C runtime initialization, should negate the need for a delay since the initialization will typically take more than 6us. */
#endif
    }

    if (BSP_WARM_START_POST_C == event)
    {
        /* C runtime environment and system clocks are setup. */

        /* Configure pins. */
        R_IOPORT_Open (&g_ioport_ctrl, &IOPORT_CFG_NAME);
    }
}

#if BSP_TZ_SECURE_BUILD

FSP_CPP_HEADER
BSP_CMSE_NONSECURE_ENTRY void template_nonsecure_callable ();

/* Trustzone Secure Projects require at least one nonsecure callable function in order to build (Remove this if it is not required to build). */
BSP_CMSE_NONSECURE_ENTRY void template_nonsecure_callable ()
{

}
FSP_CPP_FOOTER

#endif
