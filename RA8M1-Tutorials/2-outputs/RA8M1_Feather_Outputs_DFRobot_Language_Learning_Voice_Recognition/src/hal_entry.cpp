#include "hal_data.h"
#include "DFRobot_DF2301Q.h"

FSP_CPP_HEADER
void R_BSP_WarmStart(bsp_warm_start_event_t event);
FSP_CPP_FOOTER

//I2C communication
DFRobot_DF2301Q_I2C DF2301Q;

/*******************************************************************************************************************//**
 * main() is generated by the RA Configuration editor and is used to generate threads if an RTOS is used.  This function
 * is called by main() when no RTOS is used.
 **********************************************************************************************************************/
void hal_entry(void)
{
    /* TODO: add your own code here */
    // Init the sensor
      while( !( DF2301Q.begin() ) ) {
        APP_PRINT("Communication with device failed, please check connection\n");
        delay(3000);
      }
      APP_PRINT("Begin ok!\n");

      /**
       * @brief Set voice volume
       * @param voc - Volume value(1~7)
       */
      DF2301Q.setVolume(4);

      /**
       * @brief Set mute mode
       * @param mode - Mute mode; set value 1: mute, 0: unmute
       */
      DF2301Q.setMuteMode(0);

      /**
       * @brief Set wake-up duration
       * @param wakeTime - Wake-up duration (0-255)
       */
      DF2301Q.setWakeTime(15);

      /**
       * @brief Get wake-up duration
       * @return The currently-set wake-up period
       */
      uint8_t wakeTime = 0;
      wakeTime = DF2301Q.getWakeTime();
      APP_PRINT("wakeTime = ");
      APP_PRINT("%d\n",wakeTime);

      /**
       * @brief Play the corresponding reply audio according to the command word ID
       * @param CMDID - Command word ID
       * @note Can enter wake-up state through ID-1 in I2C mode
       */
      // DF2301Q.playByCMDID(1);   // Wake-up command
      DF2301Q.playByCMDID(23);   // Common word ID

      while (true) {
          /**
           * @brief Get the ID corresponding to the command word
           * @return Return the obtained command word ID, returning 0 means no valid ID is obtained
           */
          uint8_t CMDID = 0;
          CMDID = DF2301Q.getCMDID();
          if(0 != CMDID) {
            APP_PRINT("CMDID = ");
            APP_PRINT("%d\n",CMDID);
          }
          delay(3000);
      }


#if BSP_TZ_SECURE_BUILD
    /* Enter non-secure code */
    R_BSP_NonSecureEnter();
#endif
}

/*******************************************************************************************************************//**
 * This function is called at various points during the startup process.  This implementation uses the event that is
 * called right before main() to set up the pins.
 *
 * @param[in]  event    Where at in the start up process the code is currently at
 **********************************************************************************************************************/
void R_BSP_WarmStart(bsp_warm_start_event_t event)
{
    if (BSP_WARM_START_RESET == event)
    {
#if BSP_FEATURE_FLASH_LP_VERSION != 0

        /* Enable reading from data flash. */
        R_FACI_LP->DFLCTL = 1U;

        /* Would normally have to wait tDSTOP(6us) for data flash recovery. Placing the enable here, before clock and
         * C runtime initialization, should negate the need for a delay since the initialization will typically take more than 6us. */
#endif
    }

    if (BSP_WARM_START_POST_C == event)
    {
        /* C runtime environment and system clocks are setup. */

        /* Configure pins. */
        R_IOPORT_Open (&IOPORT_CFG_CTRL, &IOPORT_CFG_NAME);

#if BSP_CFG_SDRAM_ENABLED

        /* Setup SDRAM and initialize it. Must configure pins first. */
        R_BSP_SdramInit(true);
#endif
    }
}

#if BSP_TZ_SECURE_BUILD

FSP_CPP_HEADER
BSP_CMSE_NONSECURE_ENTRY void template_nonsecure_callable ();

/* Trustzone Secure Projects require at least one nonsecure callable function in order to build (Remove this if it is not required to build). */
BSP_CMSE_NONSECURE_ENTRY void template_nonsecure_callable ()
{

}
FSP_CPP_FOOTER

#endif
