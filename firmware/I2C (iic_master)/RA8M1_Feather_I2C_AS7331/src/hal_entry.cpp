#include "as7331.h"

FSP_CPP_HEADER
void R_BSP_WarmStart(bsp_warm_start_event_t event);
FSP_CPP_FOOTER

// Specify sensor parameters //
MMODE   mmode = AS7331_CONT_MODE;  // choices are modes are CONT, CMD, SYNS, SYND
CCLK    cclk  = AS7331_1024;      // choices are 1.024, 2.048, 4.096, or 8.192 MHz
uint8_t sb    = 0x01;             // standby enabled 0x01 (to save power), standby disabled 0x00
uint8_t breakTime = 40;           // sample timeMs == 8 us x breaktimeMs (0 - 255, or 0 - 2040 us range), CONT or SYNX modes

uint8_t gain = 8; // ADCGain = 2^(11-gain), by 2s, 1 - 2048 range,  0 < gain = 11 max, default 10
uint8_t timeMs = 9; // 2^time in ms, so 0x07 is 2^6 = 64 ms, 0 < time = 15 max, default  6

// sensitivities at 1.024 MHz clock
float lsbA = 304.69f / ((float)(1 << (11 - gain))) / ((float)(1 << timeMs)/1024.0f) / 1000.0f;  // uW/cm^2
float lsbB = 398.44f / ((float)(1 << (11 - gain))) / ((float)(1 << timeMs)/1024.0f) / 1000.0f;
float lsbC = 191.41f / ((float)(1 << (11 - gain))) / ((float)(1 << timeMs)/1024.0f) / 1000.0f;

uint16_t tempData= 0, UVAData = 0, UVBData = 0, UVCData = 0, allData[4] = {0, 0, 0, 0};
float temp_C = 0;
int status;

I2Cdev i2c_0;
AS7331 AS7331(&i2c_0);

/*******************************************************************************************************************//**
 * main() is generated by the RA Configuration editor and is used to generate threads if an RTOS is used.  This function
 * is called by main() when no RTOS is used.
 **********************************************************************************************************************/
void hal_entry(void) {
	AS7331.powerUp();
	AS7331.reset();
	delay(100);
	uint8_t AS7331_ID = AS7331.getChipID();
	//APP_PRINT("ID: %d\n", AS7331_ID);

	// check if AS7331 has acknowledged
	if(AS7331_ID == 0x21)  {
		AS7331.setConfigurationMode();
		AS7331.init(mmode, cclk, sb, breakTime, gain, timeMs);
		delay(100); // let sensor settle
		AS7331.setMeasurementMode();
	}
	else {
		APP_ERR_PRINT("Wrong id: %d\n", AS7331_ID);
	}

	while (true) {
		status = AS7331.getStatus();
		//APP_PRINT("Current status: %d\n", status);

		if (status & 0x0008) {
			AS7331.readAllData(allData); // burst read data in one I2C transaction takes 281 us
			tempData = allData[0];
			UVAData  = allData[1];
			UVBData  = allData[2];
			UVCData  = allData[3];

			APP_PRINT("Raw counts\n");
			APP_PRINT("AS7331 UVA = %d\n", UVAData);
			APP_PRINT("AS7331 UVB = %d\n", UVBData);
			APP_PRINT("AS7331 UVC = %d\n\n", UVCData);

			APP_PRINT("Scaled UV data\n");
			APP_PRINT("AS7331 UVA (uW/cm^2)= %d", (int)((float)(UVAData)*lsbA));
			APP_PRINT(".%d\n", (int)((float)(UVAData) * lsbA * 100 ) % 100);
			APP_PRINT("AS7331 UVB (uW/cm^2)= %d", (int)((float)(UVBData)*lsbB));
			APP_PRINT(".%d\n", (int)((float)(UVBData) * lsbB * 100) % 100);
			APP_PRINT("AS7331 UVC (uW/cm^2)= %d", (int)((float)(UVCData)*lsbC));
			APP_PRINT(".%d\n\n", (int)((float)(UVCData) * lsbC * 100)  % 100);

			temp_C = tempData * 0.05f - 66.9f;
			APP_PRINT("AS7331 Temperature = %d", (int)temp_C);
			APP_PRINT(".%d C\n\n", (int)((float)(temp_C) * 100)  % 100);
		}
	}
#if BSP_TZ_SECURE_BUILD
    /* Enter non-secure code */
    R_BSP_NonSecureEnter();
#endif
}

/*******************************************************************************************************************//**
 * This function is called at various points during the startup process.  This implementation uses the event that is
 * called right before main() to set up the pins.
 *
 * @param[in]  event    Where at in the start up process the code is currently at
 **********************************************************************************************************************/
void R_BSP_WarmStart(bsp_warm_start_event_t event) {
	if (BSP_WARM_START_RESET == event) {
#if BSP_FEATURE_FLASH_LP_VERSION != 0

        /* Enable reading from data flash. */
        R_FACI_LP->DFLCTL = 1U;

        /* Would normally have to wait tDSTOP(6us) for data flash recovery. Placing the enable here, before clock and
         * C runtime initialization, should negate the need for a delay since the initialization will typically take more than 6us. */
#endif
	}

	if (BSP_WARM_START_POST_C == event) {
		/* C runtime environment and system clocks are setup. */

		/* Configure pins. */
		R_IOPORT_Open(&g_ioport_ctrl, &IOPORT_CFG_NAME);
	}
}

#if BSP_TZ_SECURE_BUILD

FSP_CPP_HEADER
BSP_CMSE_NONSECURE_ENTRY void template_nonsecure_callable ();

/* Trustzone Secure Projects require at least one nonsecure callable function in order to build (Remove this if it is not required to build). */
BSP_CMSE_NONSECURE_ENTRY void template_nonsecure_callable ()
{

}
FSP_CPP_FOOTER

#endif
